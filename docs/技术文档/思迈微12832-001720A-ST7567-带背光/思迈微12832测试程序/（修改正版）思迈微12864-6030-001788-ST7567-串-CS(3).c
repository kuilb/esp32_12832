//IC:         st7567
//MODULE		:思迈微12864-(128X64Pixls)
//我司提供技术支持，任何技术问题欢迎随时交流学习
//创建日期:2016-04-17
//版本：V1.1
//版权所有，盗版必究。
//Copyright(C) 思迈微电子2016-2026
//All rights reserved
//接口类型:   串口
#include <reg51.h>
sbit CS=P3^0;
sbit RES=P3^1;
sbit A0=P3^2;
sbit SCL=P1^6;
sbit SDA=P1^7;
/****************************************************/
#define	nop1() _nop_()
#define	uchar	unsigned char
#define	uint unsigned	int
void    writecommand(uchar cmd);	// 写命令
void    writedata(uchar dataa);//写数据
void    writedata1(uchar dataa);//写数据
void	disp_clear(void);
void	disp_full(void);
void	disp_col(void);
void	disp_row(void);
void	dispgraphiCS(void);//dispgraphiCS
void	dispblxstp(void);//dispgraphiCS
void	dispstr(uchar	d);//显示字符，0是第一行，1是第二行
/*********************************************************************************************/
uchar str2[6]={0x3e,0x51,0x49,0x45,0x3e,0x00};//disp"0"
uchar str3[6]={0x7f,0x40,0x40,0x40,0x40,0x00};//disp"L"
/*********************************************************************************************/
uchar code graph[]={

/*--  宽度x高度=128x64  --*/
0x00,0x00,0x00,0x00,0x00,0x00,0x00,0x00,0x00,0x00,0x00,0x00,0x00,0x00,0x00,0x00,
0x00,0x00,0x00,0x00,0x00,0x00,0x00,0x00,0x00,0x00,0x00,0x00,0x00,0x00,0x00,0x00,
0x00,0x00,0x00,0x00,0x00,0x00,0x00,0x00,0x00,0x00,0x00,0x00,0x00,0x00,0x00,0x00,
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0x00,0x00,0x00,0x00,0x00,0x00,0x00,0x00,0x00,0x00,0x00,0x00,0x00,0x00,0x00,0x00


};


/************************************************************************************/
void writecommand(int cmd) //写指令
     {
       int i;
       CS=0;
       A0=0;
       for(i=0;i<8;i++)
     {
       if(cmd&0x80)
       SDA=1;
       else
       SDA=0;
       SCL=0;
       SCL=1;
       cmd=cmd<<1;
      }
       CS=1;
      }
/****************************************************/
void writedata(int dat) //写数据
     {
       int i;
       CS=0;
       A0=1;
       for(i=0;i<8;i++)
     {
       if(dat&0x80)
       SDA=1;
      else
       SDA=0;
       SCL=0;
       SCL=1;
      dat=dat<<1;
      }
       CS=1;
      }
/****************************************************/
void writedata1(int dat) //写数据  CS=1
     {
       int i;
       CS=1;
       A0=1;
       for(i=0;i<8;i++)
     {
       if(dat&0x80)
       SDA=1;
      else
       SDA=0;
       SCL=0;
       SCL=1;
      dat=dat<<1;
      }
       CS=1;
      }
/****************************************************/
void delay(unsigned int delay) //延迟程序
      {
      unsigned int i, j;

       for
      (
      i=0; i<delay; i++
      )
       for
      (
       j=0; j<100; j++
      );
      }
/****************************************************/
void lcd_init(void)//初使化
   {

        RES=1;
        delay(30);
        RES=0;
    	delay(30);
    	RES=1;
    	delay(100);

        writecommand(0xE2);

        delay(10);

        writecommand(0xA2);//0xa2设置偏压比为1/9

        writecommand(0xA0);//0xA0设置列地址从00H开始

        writecommand(0xC8);//0xc8设置com扫描方向，从COM(n-1)到 COM0

        writecommand(0x23);//vop粗调

        writecommand(0x81);//vop双指令

        writecommand(0x32);//vop微调

        writecommand(0x2F);//0x2f电源状态、输出缓冲开、内部电压调整开，电压调节开关

        writecommand(0xB0);//0xb0设置页列地址

        writecommand(0xAF);//0xaf设置显示LCD开关

        writecommand(0xA6);	//0xa6设置正常显开关
	}
/****************************************************/
 void	disp_clear(void)   //清屏
	{
          uchar	i,j;
	  for(i=0;i<9;i++)
	{
	  writecommand(0x00);
	  writecommand(0xb0+i);
          writecommand(0x00);
          writecommand(0x10);
          for(j=0;j<132;j++)
	  writedata(0x00);
	}
	}
/****************************************************/
 void	disp_full(void)    //全显
	{
          uchar	i,j;
	  for(i=0;i<9;i++)
	{
	  writecommand(0x00);
	  writecommand(0xb0+i);
          writecommand(0x00);
          writecommand(0x10);
          for(j=0;j<132;j++)
	  writedata(0xFF);
	}
	}
 /****************************************************/
 void	disp_col(void)    //横条
	{
          uchar	i,j;
	  for(i=0;i<9;i++)
	{
	  writecommand(0x00);
	  writecommand(0xb0+i);
          writecommand(0x00);
          writecommand(0x10);
          for(j=0;j<132;j++)
	  writedata(0xAA);
	}
	}
 /****************************************************/
 void	disp_row(void)     //竖条
	{
	 uchar	i,j;
	 for (i=0;i<9;i++)
        {
         writecommand(0xb0+i);
	 writecommand(0x00);
	 writecommand(0x10);
	 for(j=0;j<128;j++)
	{
	 writedata(0xFF);
	 writedata(0x00);
	}
	}
	}
 /****************************************************/
 void dispstr(uchar d)//disp"0",disp"L"
	{
	 uchar i,j,k;
	 for(i=0;i<9;i++)
	{
	 writecommand(0xb0+i);
	 writecommand(0x00);
	 writecommand(0x10);
	 for(j=0;j<22;j++)
	 if(d==0)
	{
	 for(k=0;k<6;k++)
	 writedata(str2[k]);
	}
	 else
	 for(k=0;k<6;k++)
	 writedata(str3[k]);
        }
	}
 /****************************************************/
 void	dispgraphiCS(void)   //最大框
	{
         uint	i,j;
	 for(i=0;i<9;i++)
	{
         writecommand(0xb0+i);
         writecommand(0x10);
         writecommand(0x00);
         for(j=0;j<128;j++)
	 writedata(graph[i*128+j]);
	 }
         }

  void	main()
     {
	  while(1)
     {

        lcd_init();       //初使化

        disp_clear();     //清屏
	delay(50);

	disp_full();      //全显
        delay(150);


        
        disp_row();      //竖条
        delay(200);
        
        dispstr(0);      //0画面
        delay(200);
        
        
        dispgraphiCS();   //最大框
	delay(200000);



       // disp_col();      //横条
        delay(200);



    //  dispstr(1);      //L画面
    //  delay(200);

      }
      }



